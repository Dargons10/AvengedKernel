## drivers/media/i2c/Kconfig
```kconfig
#
# Multimedia Video device configuration
#

if VIDEO_V4L2

menu "Sensors used on soc_camera driver"

if SOC_CAMERA
	source "drivers/media/i2c/soc_camera/Kconfig"
endif

endmenu

endif
```
